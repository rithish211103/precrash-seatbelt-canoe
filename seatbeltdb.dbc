VERSION ""

NS_ :

BS_:

BU_: Seatbelt_Node BCM_Node

BO_ 1280 Precrash_Lock_Message: 1 Seatbelt_Node
 SG_ Seatbelt_lock_Signal : 0|8@1+ (1,0) [0|1] "" Vector__XXX

BO_ 512 Seatbelt_Message: 1 Seatbelt_Node
 SG_ Seatbelt_Status_Signal : 8|8@1+ (1,0) [0|1] "" Vector__XXX

BO_ 1024 Engine_Message: 1 BCM_Node
 SG_ Ignition_Signal : 0|8@1+ (1,0) [0|1] "" Vector__XXX

BO_ 256 Brake_Message: 1 BCM_Node
 SG_ Brake_Pedal_Signal : 0|8@1+ (1,0) [0|1] "" Vector__XXX

BO_ 768 Acceleration_Message: 1 BCM_Node
 SG_ Velocity_Signal : 0|8@1+ (1,0) [0|240] "" Vector__XXX

EV_ lgn_Variable: 0 [0|1] "" 0 1 DUMMY_NODE_VECTOR0 Vector__XXX;

EV_ Seatbelt_Variable: 0 [0|1] "" 0 2 DUMMY_NODE_VECTOR0 Vector__XXX;

EV_ Lock_Variable: 0 [0|1] "" 0 3 DUMMY_NODE_VECTOR0 Vector__XXX;

EV_ Brake_Variable: 0 [0|1] "" 0 4 DUMMY_NODE_VECTOR0 Vector__XXX;

EV_ Acc_Variable: 0 [0|576] "" 0 5 DUMMY_NODE_VECTOR0 Vector__XXX;

BA_DEF_  "BusType" STRING ;
BA_DEF_DEF_  "BusType" "CAN";
